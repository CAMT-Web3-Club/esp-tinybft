## examples/counter/main/Kconfig.projbuild
```kconfig
menu "Counter Example Configuration"

    choice EXAMPLE_PRESET
        prompt "Experiment preset"
        default EXAMPLE_PRESET_CUSTOM
        help
            One choice per configuration of the best-vs-best comparison
            (README "Best-vs-best: configurations to run"); the name before
            the colon is the run name, printed as preset= in the BANNER.

            A preset fixes the transport, the ESP-NOW PHY rate, the Wi-Fi
            interface (station), ESP-NOW receive power saving, broadcast
            (off), UDP multicast (off: one datagram per replica), and the UDP
            power saving and listen interval. menuconfig then offers only the
            preset's option in those menus. Everything that must stay the
            same across configurations is left to you and is not changed by
            a preset: role, ESP-NOW channel, Wi-Fi TX power,
            attempts per frame, timeouts and sizes, and ESP-IDF's own
            "Minimum active time".

            Only modes that worked on the boards are offered (2026-11-15,
            8 boards): ESP-NOW at 1 Mbps and 65 Mbps; 6, 6.5, 11, 24 and
            54 Mbps lost 73-100 % of the MAC ACKs and broadcast stalled.
            The 65 Mbps presets with receive power saving have not been run
            on the boards yet.

            Custom: set every option by hand, as before (multicast,
            broadcast, other rates, custom wake window, 8 attempts, ...).
            Switching back to Custom keeps the values the last preset left.

        config EXAMPLE_PRESET_CUSTOM
            bool "Custom: set each option by hand"
        config EXAMPLE_PRESET_EN1
            bool "en1: ESP-NOW 1 Mbps, radio always on"
            select TBFT_PRESET_RADIO
            select TBFT_PRESET_ESPNOW
        config EXAMPLE_PRESET_EN65
            bool "en65: ESP-NOW 65 Mbps (MCS7), radio always on"
            select TBFT_PRESET_RADIO
            select TBFT_PRESET_ESPNOW
            select TBFT_PRESET_RATE_MCS7
        config EXAMPLE_PRESET_EN1_W50I100
            bool "en1_w50i100: ESP-NOW 1 Mbps, listen 50 ms every 100 ms"
            select TBFT_PRESET_RADIO
            select TBFT_PRESET_ESPNOW
            select TBFT_PRESET_PS_W50_I100
        config EXAMPLE_PRESET_EN1_W110I200
            bool "en1_w110i200: ESP-NOW 1 Mbps, listen 110 ms every 200 ms"
            select TBFT_PRESET_RADIO
            select TBFT_PRESET_ESPNOW
            select TBFT_PRESET_PS_W110_I200
        config EXAMPLE_PRESET_EN1_W50I200
            bool "en1_w50i200: ESP-NOW 1 Mbps, listen 50 ms every 200 ms"
            select TBFT_PRESET_RADIO
            select TBFT_PRESET_ESPNOW
            select TBFT_PRESET_PS_W50_I200
        config EXAMPLE_PRESET_EN1_T8
            bool "en1_t8: ESP-NOW 1 Mbps, radio always on, 8 attempts per frame"
            select TBFT_PRESET_RADIO
            select TBFT_PRESET_ESPNOW
            select TBFT_PRESET_RETRIES_8
        config EXAMPLE_PRESET_EN65_W50I100
            bool "en65_w50i100: ESP-NOW 65 Mbps, listen 50 ms every 100 ms"
            select TBFT_PRESET_RADIO
            select TBFT_PRESET_ESPNOW
            select TBFT_PRESET_RATE_MCS7
            select TBFT_PRESET_PS_W50_I100
        config EXAMPLE_PRESET_EN65_W110I200
            bool "en65_w110i200: ESP-NOW 65 Mbps, listen 110 ms every 200 ms"
            select TBFT_PRESET_RADIO
            select TBFT_PRESET_ESPNOW
            select TBFT_PRESET_RATE_MCS7
            select TBFT_PRESET_PS_W110_I200
        config EXAMPLE_PRESET_EN65_W50I200
            bool "en65_w50i200: ESP-NOW 65 Mbps, listen 50 ms every 200 ms"
            select TBFT_PRESET_RADIO
            select TBFT_PRESET_ESPNOW
            select TBFT_PRESET_RATE_MCS7
            select TBFT_PRESET_PS_W50_I200
        config EXAMPLE_PRESET_UDP_NONE
            bool "udp_none: UDP, power saving None"
            select TBFT_PRESET_RADIO
        config EXAMPLE_PRESET_UDP_MIN
            bool "udp_min: UDP, power saving Minimum"
            select TBFT_PRESET_RADIO
        config EXAMPLE_PRESET_UDP_MAX3
            bool "udp_max3: UDP, power saving Maximum, listen interval 3"
            select TBFT_PRESET_RADIO
        config EXAMPLE_PRESET_UDP_MAX10
            bool "udp_max10: UDP, power saving Maximum, listen interval 10"
            select TBFT_PRESET_RADIO
        config EXAMPLE_PRESET_UDP_MIN_A20
            bool "udp_min_a20: UDP, power saving Minimum, minimum active time 20 ms"
            select TBFT_PRESET_RADIO
        config EXAMPLE_PRESET_UDP_MAX3_A20
            bool "udp_max3_a20: UDP, power saving Maximum, listen interval 3, minimum active time 20 ms"
            select TBFT_PRESET_RADIO
        config EXAMPLE_PRESET_UDP_NONE_MCAST
            bool "udp_none_mcast: UDP, power saving None, IP multicast"
            select TBFT_PRESET_RADIO
            select TBFT_PRESET_MCAST
        config EXAMPLE_PRESET_UDP_MIN_MCAST
            bool "udp_min_mcast: UDP, power saving Minimum, IP multicast"
            select TBFT_PRESET_RADIO
            select TBFT_PRESET_MCAST
    endchoice

    comment "Transport, ESP-NOW rate and power saving: TinyBFT Configuration menu"
    depends on EXAMPLE_PRESET_CUSTOM

    choice EXAMPLE_LOAD
        prompt "Experiment load"
        default EXAMPLE_LOAD_B2B
        help
            How the client sends, for every preset (and Custom). The BANNER
            prints it as load= on every board.

            Back-to-back: the next request starts as soon as the previous one
            has its reply (or failed), one request outstanding, no wait. The
            cluster works all the time, so requests per joule show the cost
            of one consensus round; the radio power-saving modes hardly get
            to sleep.

            One request every 10 s: a fixed schedule (a slow request does
            not shift it; slots it overruns are counted as missed). Most of
            the time is idle, as in a lightly loaded deployment, so this is
            where the power-saving modes show what they save.

            Suggested run names: <preset> for back-to-back, <preset>_p10
            for 10 s.

        config EXAMPLE_LOAD_B2B
            bool "Back-to-back (next request as soon as the previous one completes)"
        config EXAMPLE_LOAD_P10
            bool "One request every 10 s"
    endchoice

    config EXAMPLE_LOAD_PERIOD_MS
        int
        default 10000 if EXAMPLE_LOAD_P10
        default 0
        help
            Request period of the load in ms; 0 means back-to-back.

    config EXAMPLE_PRESET_NAME
        string
        default "en1" if EXAMPLE_PRESET_EN1
        default "en65" if EXAMPLE_PRESET_EN65
        default "en1_t8" if EXAMPLE_PRESET_EN1_T8
        default "en1_w50i100" if EXAMPLE_PRESET_EN1_W50I100
        default "en1_w110i200" if EXAMPLE_PRESET_EN1_W110I200
        default "en1_w50i200" if EXAMPLE_PRESET_EN1_W50I200
        default "en65_w50i100" if EXAMPLE_PRESET_EN65_W50I100
        default "en65_w110i200" if EXAMPLE_PRESET_EN65_W110I200
        default "en65_w50i200" if EXAMPLE_PRESET_EN65_W50I200
        default "udp_none" if EXAMPLE_PRESET_UDP_NONE
        default "udp_min" if EXAMPLE_PRESET_UDP_MIN
        default "udp_max3" if EXAMPLE_PRESET_UDP_MAX3
        default "udp_max10" if EXAMPLE_PRESET_UDP_MAX10
        default "udp_min_a20" if EXAMPLE_PRESET_UDP_MIN_A20
        default "udp_max3_a20" if EXAMPLE_PRESET_UDP_MAX3_A20
        default "udp_none_mcast" if EXAMPLE_PRESET_UDP_NONE_MCAST
        default "udp_min_mcast" if EXAMPLE_PRESET_UDP_MIN_MCAST
        default "custom"
        help
            Run name of the preset, printed as preset= in the BANNER.

    # Which UDP power-saving option the preset leaves visible.
    config EXAMPLE_PRESET_PS_NONE
        bool
        default y if EXAMPLE_PRESET_UDP_NONE || EXAMPLE_PRESET_UDP_NONE_MCAST
    config EXAMPLE_PRESET_PS_MIN
        bool
        default y if EXAMPLE_PRESET_UDP_MIN || EXAMPLE_PRESET_UDP_MIN_A20
        default y if EXAMPLE_PRESET_UDP_MIN_MCAST
    config EXAMPLE_PRESET_PS_MAX
        bool
        default y if EXAMPLE_PRESET_UDP_MAX3 || EXAMPLE_PRESET_UDP_MAX10
        default y if EXAMPLE_PRESET_UDP_MAX3_A20

    config EXAMPLE_PRESET_MIN_ACTIVE_MS
        int
        depends on TBFT_PRESET_RADIO && TBFT_TRANSPORT_UDP
        default 20 if EXAMPLE_PRESET_UDP_MIN_A20 || EXAMPLE_PRESET_UDP_MAX3_A20
        default 50
        help
            Minimum active time a UDP preset sets, in ms (ESP-IDF's default
            is 50). ESP-IDF applies its own "Minimum active time" option
            only inside esp_wifi_init(), so the example calls the same
            function, esp_wifi_set_sleep_min_active_time(), right after it.
            Not set with Custom: ESP-IDF's option applies then.

    choice EXAMPLE_NODE_ROLE
        prompt "Role of this board"
        default EXAMPLE_ROLE_AUTO
        help
            Automatic: at boot the board looks itself up in the node list
            (spiffs_image/config_espnow.txt by MAC, config_udp.txt by IP).
            Entries named node* are replicas, any other entry is a client.
            One image then works on every board.
            Replica / Client: force the role. A board whose entry says
            otherwise reports it and restarts.

        config EXAMPLE_ROLE_AUTO
            bool "Automatic, from the node list (same image on every board)"
        config EXAMPLE_ROLE_REPLICA
            bool "Replica"
        config EXAMPLE_ROLE_CLIENT
            bool "Client"
    endchoice

    config EXAMPLE_ESPNOW_CHANNEL
        int "ESP-NOW Wi-Fi channel"
        default 1
        range 1 13
        depends on TBFT_TRANSPORT_ESPNOW
        help
            Channel all boards use for ESP-NOW. Use a channel that is free,
            not the access point's channel: measured on 8 boards, ESP-NOW on
            the AP's channel lost 27 % of its MAC ACKs at 1 Mbps and the
            receive power-saving modes stopped working altogether, while a
            free channel lost none. The UDP runs are on the AP's channel by
            nature; report the two channels in the results.

    menu "Wi-Fi station (UDP)"
        depends on TBFT_TRANSPORT_UDP

        config EXAMPLE_WIFI_SSID
            string "Wi-Fi SSID"
            default "myssid"
            help
                SSID of the access point. Stored in sdkconfig, which git
                ignores.

        config EXAMPLE_WIFI_PASSWORD
            string "Wi-Fi password"
            default "mypassword"
            help
                Password of the access point. Leave empty for open networks.
                Stored in sdkconfig, which git ignores.

        choice EXAMPLE_WIFI_MODEM_PS
            prompt "Power saving"
            default EXAMPLE_WIFI_PS_NONE
            help
                Station power saving (esp_wifi_set_ps()). None: radio always
                on, the counterpart of ESP-NOW with receive power saving off.
                Minimum: wakes every DTIM. Maximum: wakes every listen
                interval and may miss broadcast frames such as ARP requests.

            config EXAMPLE_WIFI_PS_NONE
                bool "None (WIFI_PS_NONE)"
                depends on EXAMPLE_PRESET_CUSTOM || EXAMPLE_PRESET_PS_NONE
            config EXAMPLE_WIFI_PS_MIN_MODEM
                bool "Minimum (WIFI_PS_MIN_MODEM)"
                depends on EXAMPLE_PRESET_CUSTOM || EXAMPLE_PRESET_PS_MIN
            config EXAMPLE_WIFI_PS_MAX_MODEM
                bool "Maximum (WIFI_PS_MAX_MODEM)"
                depends on EXAMPLE_PRESET_CUSTOM || EXAMPLE_PRESET_PS_MAX
        endchoice

        comment "Minimum active time: Component config > Wi-Fi > Minimum active time"
        depends on !EXAMPLE_WIFI_PS_NONE && EXAMPLE_PRESET_CUSTOM

        config EXAMPLE_WIFI_LISTEN_INTERVAL
            int "Listen interval (beacon intervals)" if EXAMPLE_PRESET_CUSTOM
            default 10 if EXAMPLE_PRESET_UDP_MAX10
            default 3
            range 1 10
            depends on EXAMPLE_WIFI_PS_MAX_MODEM
            help
                listen_interval of the station: with WIFI_PS_MAX_MODEM it
                wakes for every this many beacons. Set explicitly so the
                experiment does not depend on the driver default.

        config EXAMPLE_STATIC_IP
            bool "Derive a static IP from this board's MAC (no DHCP reservation)"
            default n
            help
                Looks up this board's station MAC in spiffs config_espnow.txt and
                uses the IP at the same index in config_udp.txt. One firmware
                then works on every board without router reservations.

        config EXAMPLE_STATIC_IP_NETMASK
            string "Static IP netmask"
            default "255.255.255.0"
            depends on EXAMPLE_STATIC_IP

        config EXAMPLE_STATIC_IP_GATEWAY
            string "Static IP gateway (router)"
            default "192.168.100.1"
            depends on EXAMPLE_STATIC_IP
    endmenu

    comment "Log level: Component config > Log > Log Level > Default log verbosity"

endmenu
```
