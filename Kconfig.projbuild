## examples/counter/main/Kconfig.projbuild
```kconfig
menu "Counter Example Configuration"

    comment "Transport, ESP-NOW rate and power saving: TinyBFT Configuration menu"

    choice EXAMPLE_NODE_ROLE
        prompt "Role of this board"
        default EXAMPLE_ROLE_AUTO
        help
            Automatic: at boot the board looks itself up in the node list
            (spiffs_image/config_espnow.txt by MAC, config_udp.txt by IP).
            Entries named node* are replicas, any other entry is a client.
            One image then works on every board.
            Replica / Client: force the role. A board whose entry says
            otherwise reports it and restarts.

        config EXAMPLE_ROLE_AUTO
            bool "Automatic, from the node list (same image on every board)"
        config EXAMPLE_ROLE_REPLICA
            bool "Replica"
        config EXAMPLE_ROLE_CLIENT
            bool "Client"
    endchoice

    config EXAMPLE_CLIENT_REQUEST_INTERVAL_MS
        int "Client: request period (ms)"
        default 10000
        range 100 3600000
        depends on !EXAMPLE_ROLE_REPLICA
        help
            The client starts one request every this many ms on a fixed
            schedule: a slow request does not shift the schedule, and slots
            it overruns are counted as "missed". Keep it the same for every
            configuration you compare.

    config EXAMPLE_ESPNOW_CHANNEL
        int "ESP-NOW Wi-Fi channel"
        default 1
        range 1 13
        depends on TBFT_TRANSPORT_ESPNOW
        help
            Channel all boards use for ESP-NOW. Use the same channel as the
            router in the UDP runs so both transports share the RF environment.

    menu "Wi-Fi station (UDP)"
        depends on TBFT_TRANSPORT_UDP

        config EXAMPLE_WIFI_SSID
            string "Wi-Fi SSID"
            default "myssid"
            help
                SSID of the access point. Stored in sdkconfig, which git
                ignores.

        config EXAMPLE_WIFI_PASSWORD
            string "Wi-Fi password"
            default "mypassword"
            help
                Password of the access point. Leave empty for open networks.
                Stored in sdkconfig, which git ignores.

        choice EXAMPLE_WIFI_MODEM_PS
            prompt "Power saving"
            default EXAMPLE_WIFI_PS_NONE
            help
                Station power saving (esp_wifi_set_ps()). None: radio always
                on, the counterpart of ESP-NOW with receive power saving off.
                Minimum: wakes every DTIM. Maximum: wakes every listen
                interval and may miss broadcast frames such as ARP requests.

            config EXAMPLE_WIFI_PS_NONE
                bool "None (WIFI_PS_NONE)"
            config EXAMPLE_WIFI_PS_MIN_MODEM
                bool "Minimum (WIFI_PS_MIN_MODEM)"
            config EXAMPLE_WIFI_PS_MAX_MODEM
                bool "Maximum (WIFI_PS_MAX_MODEM)"
        endchoice

        comment "Minimum active time: Component config > Wi-Fi > Minimum active time"
        depends on !EXAMPLE_WIFI_PS_NONE

        config EXAMPLE_WIFI_LISTEN_INTERVAL
            int "Listen interval (beacon intervals)"
            default 3
            range 1 10
            depends on EXAMPLE_WIFI_PS_MAX_MODEM
            help
                listen_interval of the station: with WIFI_PS_MAX_MODEM it
                wakes for every this many beacons. Set explicitly so the
                experiment does not depend on the driver default.

        config EXAMPLE_STATIC_IP
            bool "Derive a static IP from this board's MAC (no DHCP reservation)"
            default n
            help
                Looks up this board's station MAC in spiffs config_espnow.txt and
                uses the IP at the same index in config_udp.txt. One firmware
                then works on every board without router reservations.

        config EXAMPLE_STATIC_IP_NETMASK
            string "Static IP netmask"
            default "255.255.255.0"
            depends on EXAMPLE_STATIC_IP

        config EXAMPLE_STATIC_IP_GATEWAY
            string "Static IP gateway (router)"
            default "192.168.100.1"
            depends on EXAMPLE_STATIC_IP
    endmenu

    comment "Log level: Component config > Log > Log Level > Default log verbosity"

endmenu
```

## examples/simple_wallet/main/Kconfig.projbuild
```kconfig
menu "Simple Wallet Example Configuration"

    choice EXAMPLE_NODE_ROLE
        prompt "Node role"
        default EXAMPLE_ROLE_REPLICA
        help
            Select whether this node runs as a BFT replica or a client.

        config EXAMPLE_ROLE_REPLICA
            bool "Replica"
        config EXAMPLE_ROLE_CLIENT
            bool "Client"
    endchoice

    config EXAMPLE_WIFI_SSID
        string "WiFi SSID"
        default "myssid"
        depends on TBFT_TRANSPORT_UDP
        help
            SSID of the AP to connect to when using UDP transport.

    config EXAMPLE_WIFI_PASSWORD
        string "WiFi Password"
        default "mypassword"
        depends on TBFT_TRANSPORT_UDP
        help
            Password of the AP. Leave empty for open networks.

    config EXAMPLE_ESPNOW_CHANNEL
        int "ESP-NOW Wi-Fi channel"
        default 1
        range 1 13
        depends on TBFT_TRANSPORT_ESPNOW
        help
            Channel all boards use for ESP-NOW. Use the same channel as the
            router in the UDP runs so both transports share the RF environment.

endmenu
```
